/* ************************************************************************************************** */
/* ************************************************************************************************** */
/* ************************************************************************************************** */
/* ************************************************************************************************** */
/*   ----------------------------------------------------------------------------------------------   */
/*                                          小鸡叽叽科技出品                                          */
/*                                         www.xiaojijiji.com                                         */
/*   ----------------------------------------------------------------------------------------------   */
/* ************************************************************************************************** */
/* ************************************************************************************************** */
/* ************************************************************************************************** */
/* ************************************************************************************************** */
/*   ----------------------------------------------------------------------------------------------   */
/*                       感谢您支持小鸡叽叽科技，请遵守保密协议，保护作者的劳动成果                   */
/*                                  未经允许请不要将资料、代码传送他人或者网络                        */
/*                                           仅供内部使用                                             */
/* ************************************************************************************************** */



#include "Reg_SP37.h"
#include "SP37_ROMLibrary.h"
#include <uart.h>
#include <SP37.h>
#include <RF.h>
#include <LF.h>

#include <absacc.h>		//绝对地址访问包含头文件


/* ***************************************************************************** */
/* 此例程为LF报文侦测模式，只有Wakeup ID匹配的时候才会唤醒                       */
/* Wakeup ID取决于"LF激励源发射的ID"                                             */
/* LF 相关文档请参考"SP37_LF_v1.0.pdf","SP37_Datasheet_V1.0.pdf"                 */
/* 文档位于"SP37 相关资料"或者"SP37 芯片数据手册"                                */
/* ***************************************************************************** */


/* ***************************************************************************** */
/*特别注意:                                                                      */
/*LF接收数据的时候,唤醒之后,不能有太多的延时(太多的延时会干扰到整个LF接收过程)   */
/*例如在LF_DataReceive之前调用Printf(Printf也是一个非常耗费时间的函数)           */
/*本例子唤醒之后,做LF处理之后,统一Printf数据出来
/* ***************************************************************************** */

void MAIN(void)
{
	unsigned char store_wuf;
	
	Uart_Init();

	store_wuf = WUF;						//记录唤醒源

	if(store_wuf == 0x00){			//第一次上电的时候,进行配置
		LF_Configure_Telegram();	
	}
	if(store_wuf & 0x04){
		unsigned char i;
		unsigned char LF_ReceiveCount = 0;
		LF_ReceiveCount = LF_DataReceive();
		//打印LF数据
		if(LF_ReceiveCount){
			printf("Get A LF Telegram:  ");
			for(i=0;i<LF_ReceiveCount;i++){
				printf("0x%02X,",(int)(LFData[i]));
			}
			printf("\r\n");
		}
	}

	Powerdown();
}

