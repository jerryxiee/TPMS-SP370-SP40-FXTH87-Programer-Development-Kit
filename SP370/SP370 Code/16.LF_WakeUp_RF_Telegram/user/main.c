/* ************************************************************************************************** */
/* ************************************************************************************************** */
/* ************************************************************************************************** */
/* ************************************************************************************************** */
/*   ----------------------------------------------------------------------------------------------   */
/*                                          小鸡叽叽科技出品                                          */
/*                                         www.xiaojijiji.com                                         */
/*   ----------------------------------------------------------------------------------------------   */
/* ************************************************************************************************** */
/* ************************************************************************************************** */
/* ************************************************************************************************** */
/* ************************************************************************************************** */
/*   ----------------------------------------------------------------------------------------------   */
/*                       感谢您支持小鸡叽叽科技，请遵守保密协议，保护作者的劳动成果                   */
/*                                  未经允许请不要将资料、代码传送他人或者网络                        */
/*                                           仅供内部使用                                             */
/* ************************************************************************************************** */



#include "Reg_SP37.h"
#include "SP37_ROMLibrary.h"
#include <uart.h>
#include <SP37.h>
#include <RF.h>
#include <LF.h>

#include <absacc.h>		//绝对地址访问包含头文件


/* ***************************************************************************** */
/* 此例程为LF报文侦测模式，只有Wakeup ID匹配的时候才会唤醒                       */
/* Wakeup ID取决于"LF激励源发射的ID"                                             */
/* LF 相关文档请参考"SP37_LF_v1.0.pdf","SP37_Datasheet_V1.0.pdf"                 */
/* 文档位于"SP37 相关资料"或者"SP37 芯片数据手册"                                */
/* 唤醒之后RF一包数据(传感器相关数据)                                            */
/* ***************************************************************************** */

void MAIN(void)
{
	unsigned char store_wuf;
	unsigned char StatusByte;
	T_SP37_DATA idata t_sp37;
	unsigned char randtemp=0;

	store_wuf = WUF;						//记录唤醒源

	if(store_wuf == 0x00){			//第一次上电的时候,进行配置
															//第一次上电的时候WUF = 0x00
		LF_Configure_Telegram();
												
		//随机数初始化(用于RF的时候随机延时)
		SP37_InitRandom();		
	}
	if(store_wuf & 0x04){
		
		//串口初始化
		Uart_Init();
		printf("LF Wake Up For Pattern 0...\r\n");	//报文唤醒
		
		//RF433初始化
		Send_RF_Init();

		Read_SP37_ID(&t_sp37.IDH,&t_sp37.IDL);
		Read_ID(&t_sp37.ID_Result);
		t_sp37.Tyre_Position = Read_Tyre_Position();		
		
		Measure_Pressure(&t_sp37.Pressure);
		Measure_Temperature(&t_sp37.Temperature);
		Measure_Acceleration(&t_sp37.Acceleration);
		Measure_Supply_Voltage(&t_sp37.Voltage);
		
		StatusByte = Send_RF(t_sp37);
		
		if(!StatusByte)
			printf("Send_RF Succeed\r\n");
		else
			printf("Send_RF ERROR\r\n");	
	}

	Powerdown();
}

