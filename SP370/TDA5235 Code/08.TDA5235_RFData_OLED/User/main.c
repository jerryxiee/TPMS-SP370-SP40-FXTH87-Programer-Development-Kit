#include "sys.h"
#include "clock.h"
#include "delay.h"
#include "usart.h"
#include "led.h"
#include "tim.h"

#include "oled.h"
#include "display.h"

#include "TDA5235.h"
#include "TDA5235_SFR.h"

/* ************************************************************************************************** */
/* ************************************************************************************************** */
/* ************************************************************************************************** */
/* ************************************************************************************************** */
/*   ----------------------------------------------------------------------------------------------   */
/*                                          小鸡叽叽科技出品                                          */
/*                                         www.xiaojijiji.com                                         */
/*   ----------------------------------------------------------------------------------------------   */
/* ************************************************************************************************** */
/* ************************************************************************************************** */
/* ************************************************************************************************** */
/* ************************************************************************************************** */
/*   -----------------------------------------------------------------------------------------------  */
/*	                     感谢您支持小鸡叽叽科技，请遵守保密协议，保护作者的劳动成果，                 */
/*                                  未经允许请不要将资料、代码传送他人或者网络	                      */
/*                                             仅供内部使用                                           */
/* ************************************************************************************************** */


int main(void)
{

	Clock_Init();
	NVIC_Configuration();		//中断配置
	delay_init();
	USART1_Init(115200);		//USART1初始化,波特率115200

	Tim3_Init(1000,64); 		//1ms的溢出中断 //系统灯闪烁
	TIM3_Cmd(ENABLE);

	LED_Init();	

	OLED_Init(); 
 
	Display_Logo();  
	Display_Http();
	Display_Version();  
	Display_RF_Receive_Mark();

	Display_Data(TDA5235_FIFO);

	TDA5235_Init();
	TDA5235_SFR_Init();
	
	while(1)
	{
		if(TDA5235_FIFO_NUM){
			u8 i;
			printf("Receive Data From SP37: ");
			for(i=0;i<TDA5235_FIFO_NUM;i++){
				printf("%02X, ",TDA5235_FIFO[i]);
			}
			printf("\r\n");

			LED_ReceiveReverse();		//STATUS灯闪烁
			Display_RF_Receive_Count_Plus();
			Display_Logo_Move();

			Display_Data(TDA5235_FIFO);

			TDA5235_FIFO_NUM = 0;	//清零
		}
	}


}


/*	头文件路径
.\CORE;..\FWLib\inc;.\INCLUDE
*/

